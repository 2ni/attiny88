/*
 * library to control ST7789
 *
 * BLK off & RST low -> 300uA consumption
 * RST init sequence needed or it won't show anything
 * if device resetted, init() needed to show last screen again
 *
 */
#include <util/delay.h>
#include <avr/pgmspace.h>
#include "st7789.h"
#include "spi.h"
#include "def.h"
#include "uart.h"

// char set
const uint8_t char_map[96][6] PROGMEM = {
{ 0x00, 0x00, 0x00, 0x00, 0x00 }, // space (32)
{ 0x00, 0x00, 0x5F, 0x00, 0x00 }, // !
{ 0x00, 0x07, 0x00, 0x07, 0x00 }, // "
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{ 0xFF, 0xFF, 0xFF, 0xFF, 0xFF }
};

void st7789_send_data(uint8_t data) {
  // DF("dat: 0x%02x", data);
  PORTD |= _BV(DC); // DC high
  spi_fast_shift(data);
}

void st7789_send_cmd(uint8_t cmd) {
  // DF("cmd: 0x%02x", cmd);
  PORTD &= ~_BV(DC); // DC low
  spi_fast_shift(cmd);
}

void st7789_send_multi_data(uint8_t* buf, uint8_t len) {
  PORTD |= _BV(DC); // DC high
  spi_transmit_sync(buf, len);
}

void st7789_set_addr_window(uint8_t x0, uint8_t y0, uint8_t x1, uint8_t y1) {
  st7789_send_cmd(ST7789_CASET); // column
  st7789_send_data(0);
  st7789_send_data(x0);
  st7789_send_data(0);
  st7789_send_data(x1);

  st7789_send_cmd(ST7789_RASET); // row
  st7789_send_data(0);
  st7789_send_data(y0);
  st7789_send_data(0);
  st7789_send_data(y1);

  st7789_send_cmd(ST7789_RAMWR); // write to RAM
}

/*
 * convert rgb color to uint16_t value
 */
uint16_t st7789_convert_color(uint8_t r, uint8_t g, uint8_t b) {
  return (r & 0xf8)<<8 | (g & 0xfc)<<3 | b>>3;
}

void st7789_init() {
  uint8_t invert=1, rotate=0;

  DDR_SPI |= _BV(RST); // define RST as output
  DDRD |= _BV(DC);     // define DC as output
  DDR_BLK |= _BV(BLK); // define BLK as output

  spi_init(3); // spi mode 3 for 240x240 lcd w/o CS

  // st7789 init sequence
  // rst process seems to be needed
  /*
  PORT_SPI |= _BV(RST); // high
  _delay_ms(50);
  PORT_SPI &= ~_BV(RST); // low
  _delay_ms(50);
  */
  PORT_SPI |= _BV(RST); // high
  _delay_ms(50);

  st7789_send_cmd(0x01);        // software reset
  _delay_ms(150);
  st7789_send_cmd(0x11);        // out of sleep mode
  // _delay_ms(500);            // doesn't seem to be needed
  st7789_send_cmd(0x3a);
  st7789_send_data(0x05);       // color mode 16bit
  st7789_send_cmd(0x20+invert); // invert
  st7789_send_cmd(0x36);
  st7789_send_data(rotate<<5);  // MADCTL
  st7789_send_cmd(0x29);        // display on
  // _delay_ms(100);            // doesn't seem to be needed
}

void st7789_on() {
  PORT_BLK |= _BV(BLK); // high
}

void st7789_off() {
  PORT_BLK &= ~_BV(BLK); // low
}

void st7789_sleep() {
  st7789_send_cmd(ST7789_SLPIN);
  st7789_off();
  _delay_ms(5);
}

void st7789_wakeup() {
  st7789_send_cmd(ST7789_SLPOUT);
  st7789_on();
  _delay_ms(120);
}

void st7789_draw_point(uint8_t x, uint8_t y, uint16_t color) {
  // swap coordinates for now
  uint8_t tmp = y;
  y = x;
  x = tmp;
  y = ST7789_TFTHEIGHT - y;
  x = ST7789_TFTWIDTH - x;

  st7789_send_cmd(ST7789_RASET);
  uint8_t buf_y[4] = { 0, y, 0, y };
  st7789_send_multi_data(buf_y, 4);

  st7789_send_cmd(ST7789_CASET);
  uint8_t buf_x[4] = { 0, x, 0, x };
  st7789_send_multi_data(buf_x, 4);

  st7789_send_cmd(ST7789_RAMWR);
  st7789_send_data(color >> 8);
  st7789_send_data(color & 0xff);
}

void st7789_fill_rect(uint8_t x, uint8_t y, uint8_t w, uint8_t h, uint16_t color) {
  // swap coordinates for now
  uint8_t tmp = y;
  y = x;
  x = tmp;
  y = ST7789_TFTHEIGHT - y - h;
  x = ST7789_TFTWIDTH - x - w;

  if ((x >= ST7789_TFTWIDTH) || (y >= ST7789_TFTHEIGHT)) return;

  if ((x + w - 1) >= ST7789_TFTWIDTH) w = ST7789_TFTWIDTH - x;
  if ((y + h - 1) >= ST7789_TFTHEIGHT) w = ST7789_TFTHEIGHT - y;

  st7789_set_addr_window(x, y, x+w-1, y+h-1);

  uint8_t hi = color >> 8, lo = color & 0xFF;

  PORTD |= _BV(DC); // DC high
  for (y=h; y>0; y--) {
    for (x=w; x>0; x--) {
      spi_fast_shift(hi);
      spi_fast_shift(lo);
    }
  }
}

void st7789_fill_screen(uint16_t color) {
  st7789_fill_rect(0, 0, ST7789_TFTWIDTH, ST7789_TFTHEIGHT, color);
}

/*
 * ASCII char at x, y with bottom left corner
 */
void st7789_char(char c, uint8_t x, uint8_t y, uint8_t scale, uint16_t fgcolor, uint16_t bgcolor) {
  // swap coordinates for now
  uint8_t tmp = y;
  y = x;
  x = tmp;
  y = ST7789_TFTHEIGHT - y - 5*scale;
  x = ST7789_TFTWIDTH - x - 8*scale;

  uint16_t colour;
  st7789_set_addr_window(x, y, x+8*scale-1, y+6*scale-1);
  PORTD |= _BV(DC); // DC high

  for (uint8_t xx=5; xx>0; xx--) {
    uint8_t bits = pgm_read_byte(&char_map[c-32][xx-1]);
    // DF("0x%02x", bits);
    for (uint8_t xr=0; xr<scale; xr++) {
      for (uint8_t yy=8; yy>0; yy--) {
        if (bits>>(7-(yy-1)) & 1) colour = fgcolor; else colour = bgcolor;
        for (uint8_t yr=0; yr<scale; yr++) {
          spi_fast_shift(colour >> 8);
          spi_fast_shift(colour & 0xFF);
        }
      }
    }
  }
}

/*
 * render array of char
 */
void st7789_text(char* text, uint8_t length, uint8_t x, uint8_t y, uint8_t scale, uint8_t space, uint16_t fgcolor, uint16_t bgcolor) {
  for (uint8_t i=0; i<length; i++) {
    st7789_char(text[i], x, y, scale, fgcolor, bgcolor);
    x += 5*scale+space; // might add spacing
  }
}
